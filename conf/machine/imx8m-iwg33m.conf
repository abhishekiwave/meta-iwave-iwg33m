## conf/machine/imx8m-iwg33m.conf
```bitbake
#@TYPE: Machine
#@NAME: IWAVE i.MX8M iW-Rainbow-G33 SOM
#@SOC: i.MX8M
#@DESCRIPTION: Machine configuration for i.MX8M IWG33M
#@MAINTAINER: Geetha G <support.ip@iwavesystems.com>

MACHINEOVERRIDES =. "mx8:mx8m:mx8mq:iwg33m:"
hostname_pn-base-files = "imx8m-iwg33m"

require conf/machine/include/imx-base.inc
require conf/machine/include/tune-cortexa53.inc

MACHINE_FEATURES += "pci wifi bluetooth optee alsa"

IMAGE_INSTALL_append += " linux-firmware-rtl8168 tzdata dhcpcd obexftp obex-data-server glibc-gconv-utf-16 iwtest connman-config mrvl-wireless-firmware mrvl-wireless-modules"
LICENSE_FLAGS_WHITELIST = "commercial"

MACHINE_SOCARCH_FILTER_append_mx8mq = " virtual/libopenvg virtual/libgles1 virtual/libgles2 virtual/egl virtual/mesa virtual/libgl virtual/libg2d"

KERNEL_DEVICETREE = "freescale/imx8mq-iwg33m-lcdif-rm67198.dtb freescale/imx8mq-iwg33m-dcss-hdmi.dtb freescale/imx8mq-iwg33m-dcss-rm67198.dtb"
KERNEL_DEVICETREE += " freescale/imx8mq-iwg33m-dcss-dp.dtb freescale/imx8mq-iwg33m-m4-dcss-rm67198.dtb freescale/imx8mq-iwg33m-typec.dtb"

UBOOT_CONFIG ??= "sd"
UBOOT_CONFIG[sd] = "imx8mq_iwg33m_defconfig,sdcard"
UBOOT_CONFIG[mfgtool] = "imx8mq_iwg33m_defconfig"
SPL_BINARY = "spl/u-boot-spl.bin"

# Set DDR FIRMWARE
DDR_FIRMWARE_NAME = "lpddr4_pmu_train_1d_imem.bin lpddr4_pmu_train_1d_dmem.bin lpddr4_pmu_train_2d_imem.bin lpddr4_pmu_train_2d_dmem.bin"

# Set u-boot DTB
UBOOT_DTB_NAME = "imx8mq-iwg33m.dtb"

# Set imx-mkimage boot target
IMXBOOT_TARGETS = "flash_hdmi_spl_uboot flash_dp_spl_uboot"
TEE_LOAD_ADDR = "0xbe000000"

# Set Serial console
SERIAL_CONSOLES = "115200;ttymxc0"

IMAGE_BOOTLOADER = "iwg33m-boot"

LOADADDR = ""
UBOOT_SUFFIX = "bin"
UBOOT_MAKE_TARGET = ""
IMX_BOOT_SEEK = "33"

OPTEE_BIN_EXT = "8mq"

# Add additional firmware
MACHINE_FIRMWARE_append = " linux-firmware-ath10k"

PREFERRED_PROVIDER_virtual/bootloader_imx_iwg33m = "u-boot-iwg33m"
PREFERRED_PROVIDER_virtual/kernel_imx_iwg33m = "linux-iwg33m"
PREFERRED_PROVIDER_u-boot-mfgtool = "u-boot-iwg33m-mfgtool"
PREFERRED_VERSION_optee-os_iwg33m = "3.7.0.iwg33m"
PREFERRED_VERSION_imx-boot = "1.0.iwg33m"

# Use gstreamer 1.14 from meta-freescale
PREFERRED_VERSION_gstreamer1.0 ?= "1.14.imx"
PREFERRED_VERSION_gstreamer1.0-plugins-base ?= "1.14.imx"
PREFERRED_VERSION_gstreamer1.0-plugins-good ?= "1.14.imx"
PREFERRED_VERSION_gstreamer1.0-plugins-bad ?= "1.14.imx"
PREFERRED_VERSION_gstreamer1.0-libav ?= "1.14.0"
```
